## Tester/Firmware/_Deprecated/boards/arm/telescope_mirror_tester/telescope_mirror_tester_defconfig
```kconfig
CONFIG_SOC_SERIES_SAMD51=y
CONFIG_SOC_PART_NUMBER_SAMD51J18A=y
CONFIG_BOARD_TELESCOPE_MIRROR_TESTER=y
CONFIG_SOC_ATMEL_SAMD5X_OSCULP32K_AS_MAIN=y
CONFIG_CORTEX_M_SYSTICK=y
CONFIG_ARM_MPU=y
CONFIG_CONSOLE=y
CONFIG_UART_CONSOLE=y
CONFIG_UART_INTERRUPT_DRIVEN=y
CONFIG_SERIAL=y
CONFIG_PINMUX=y
CONFIG_UART_SAM0=n
CONFIG_GPIO=y
CONFIG_PWM=y
CONFIG_I2C=y
CONFIG_SPI=y
CONFIG_DAC=y
CONFIG_REGULATOR=y
CONFIG_DAC_MCP4716=y
CONFIG_DAC_MCP4716_INIT_PRIORITY=90
CONFIG_PMW3360=y
CONFIG_PMW3360_INIT_PRIORITY=90
CONFIG_VIDEO=y
CONFIG_VIDEO_BUFFER_POOL_SZ_MAX=2048
CONFIG_VIDEO_BUFFER_POOL_NUM_MAX=2
CONFIG_HEAP_MEM_POOL_SIZE=4096
```

## Tester/Firmware/_Deprecated/mcp4716_driver_module/zephyr/Kconfig
```kconfig
config DAC_MCP4716
	bool "Microchip DAC driver"
	depends on I2C
	help
	  Enable the driver for the Microchip MCP4716.

config DAC_MCP4716_INIT_PRIORITY
	int "Init priority"
	depends on DAC_MCP4716
	default 80
	help
	  MCP4716 DAC device driver initialization priority.
```

## Tester/Firmware/boards/arm/telescope_mirror_tester/Kconfig.defconfig
```kconfig
# Telescope Mirror Tester board configuration

# Copyright (c) 2020 Google LLC.
# SPDX-License-Identifier: Apache-2.0

if BOARD_TELESCOPE_MIRROR_TESTER

config BOARD
	default "Telescope Mirror Tester"

endif # BOARD_TELESCOPE_MIRROR_TESTER
```

## Tester/Firmware/boards/arm/telescope_mirror_tester/telescope_mirror_tester_defconfig
```kconfig
# SPDX-License-Identifier: Apache-2.0

CONFIG_SOC_SERIES_SAMD51=y
CONFIG_SOC_PART_NUMBER_SAMD51J18A=y
CONFIG_BOARD_TELESCOPE_MIRROR_TESTER=y
CONFIG_SOC_ATMEL_SAMD5X_OSCULP32K_AS_MAIN=y
CONFIG_CORTEX_M_SYSTICK=y
CONFIG_ARM_MPU=y
CONFIG_CONSOLE=y
CONFIG_UART_CONSOLE=y
CONFIG_UART_INTERRUPT_DRIVEN=y
CONFIG_SERIAL=y
CONFIG_PINMUX=y
CONFIG_DAC_SAM0=n
CONFIG_UART_SAM0=n
CONFIG_DAC_MCP4716=y
```

## Tester/Firmware/drivers/sensor/Kconfig
```kconfig
#
# Copyright (c) 2019 Nordic Semiconductor
#
# SPDX-License-Identifier: LicenseRef-Nordic-5-Clause
#

menuconfig SENSOR
	bool "Sensor Drivers"
	help
		Include sensor drivers in config

if SENSOR

rsource "pmw3360/Kconfig"

endif # SENSOR
```

## Tester/Firmware/pmw3360_driver_module/zephyr/Kconfig
```kconfig
config PMW3360
	bool "PMW3360 mouse optical sensor"
	depends on SPI
	help
	  Enable PMW3360 mouse optical sensor.

config PMW3360_INIT_PRIORITY
	int "Init priority"
	depends on PMW3360
	default 80
	help
	  PMW3360 mouse optical sensor device driver initialization priority.
```
